## tests/persist_state/testcase.yaml
```yaml
tests:
  led_threads.persist_state:
    platform_allow:
      - native_sim
    tags:
      - persist
      - app
```

## tests/supervisor/testcase.yaml
```yaml
tests:
  led_threads.supervisor:
    platform_allow:
      - native_sim
    tags:
      - supervisor
      - app
```
