## CMakeLists.txt
```
cmake_minimum_required(VERSION 3.20.0)

set(KCONFIG_ROOT ${CMAKE_CURRENT_SOURCE_DIR}/../../Kconfig)
find_package(Zephyr REQUIRED HINTS $ENV{ZEPHYR_BASE})
project(persist_state_tests)

target_sources(app PRIVATE ../../src/persist_state.c)
target_include_directories(app PRIVATE ../../src)
```

## prj.conf
```kconfig
CONFIG_ZTEST=y
CONFIG_ZTEST_ASSERT_VERBOSE=1

CONFIG_LOG=y
CONFIG_LOG_MODE_IMMEDIATE=y
CONFIG_LOG_DEFAULT_LEVEL=3
CONFIG_LOG_PRINTK=n

CONFIG_FLASH=y
CONFIG_FLASH_SIMULATOR=y
CONFIG_FLASH_MAP=y
CONFIG_NVS=y

CONFIG_MAIN_STACK_SIZE=2048
```

## app.overlay
```dts
/delete-node/ &storage_partition;

&flash0 {
	partitions {
		compatible = "fixed-partitions";
		#address-cells = <1>;
		#size-cells = <1>;

		storage_partition: partition@0 {
			label = "storage";
			reg = <0x00000000 0x00004000>;
		};
	};
};
```

## src/main.c
```c
#include <zephyr/ztest.h>

#include "persist_state.h"

static void *persist_setup(void)
{
	persist_state_test_reset();
	int rc = persist_state_init();
	zassert_ok(rc, "persist_state_init failed (%d)", rc);
	return NULL;
}

static void persist_before(void *fixture)
{
	ARG_UNUSED(fixture);
	persist_state_test_reset();
	int rc = persist_state_init();
	zassert_ok(rc, "persist_state_init failed (%d)", rc);
}

ZTEST_SUITE(persist_state_suite, NULL, persist_setup, persist_before, NULL, NULL);

ZTEST(persist_state_suite, test_watchdog_counters)
{
	zassert_equal(persist_state_get_consecutive_watchdog(), 0U,
		      "consecutive counter should start at 0");
	zassert_equal(persist_state_get_total_watchdog(), 0U,
		      "total counter should start at 0");

	persist_state_record_boot(true);
	zassert_equal(persist_state_get_consecutive_watchdog(), 1U,
		      "consecutive counter increments on watchdog reset");
	zassert_equal(persist_state_get_total_watchdog(), 1U,
		      "total counter increments on watchdog reset");

	persist_state_record_boot(true);
	zassert_equal(persist_state_get_consecutive_watchdog(), 2U,
		      "consecutive counter accumulates successive watchdog resets");
	zassert_equal(persist_state_get_total_watchdog(), 2U,
		      "total counter accumulates successive watchdog resets");

	persist_state_record_boot(false);
	zassert_equal(persist_state_get_consecutive_watchdog(), 0U,
		      "non-watchdog boot clears consecutive counter");
	zassert_equal(persist_state_get_total_watchdog(), 2U,
		      "total counter persists across clean boot");
}

ZTEST(persist_state_suite, test_fallback_activation)
{
	uint32_t threshold = CONFIG_APP_RESET_WATCHDOG_THRESHOLD;

	for (uint32_t i = 0U; i < (threshold - 1U); ++i) {
		persist_state_record_boot(true);
	}

	zassert_false(persist_state_is_fallback_active(),
		     "fallback should not trigger before threshold");

	persist_state_record_boot(true);
	zassert_true(persist_state_is_fallback_active(),
		    "fallback triggers at threshold");

	persist_state_record_boot(false);
	zassert_false(persist_state_is_fallback_active(),
		     "clean boot exits fallback mode");
}

ZTEST(persist_state_suite, test_watchdog_override_persistence)
{
	zassert_equal(persist_state_get_watchdog_override(), 0U,
		      "override should default to 0");

	int rc = persist_state_set_watchdog_override(2500U);
	zassert_ok(rc, "setting override should succeed (%d)", rc);
	zassert_equal(persist_state_get_watchdog_override(), 2500U,
		      "override should reflect stored value");

	persist_state_test_reload();
	rc = persist_state_init();
	zassert_ok(rc, "persist_state_init after reload failed (%d)", rc);
	zassert_equal(persist_state_get_watchdog_override(), 2500U,
		      "override should persist across reload");

	rc = persist_state_set_watchdog_override(0U);
	zassert_ok(rc, "clearing override should succeed (%d)", rc);
	zassert_equal(persist_state_get_watchdog_override(), 0U,
		      "override should clear to 0");
}
```
